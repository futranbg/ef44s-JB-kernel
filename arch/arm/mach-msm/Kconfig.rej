## arch/arm/mach-msm/Kconfig.rej
```kconfig
diff a/arch/arm/mach-msm/Kconfig b/arch/arm/mach-msm/Kconfig	(rejected hunks)
@@ -1618,6 +1618,12 @@ config MSM_CPU_FREQ_MIN
 
 endif # CPU_FREQ_MSM
 
+config INTELLI_PLUG
+	bool "Enable intelli-plug cpu hotplug driver"
+	default n
+	help
+	  Generic Intelli-plug cpu hotplug driver for ARM SOCs
+
 config MSM_CPUFREQ_LIMITER
 	tristate "MSM CPU frequency limiter"
 	default n
```

## block/Kconfig.iosched.rej
```kconfig
diff a/block/Kconfig.iosched b/block/Kconfig.iosched	(rejected hunks)
@@ -76,6 +76,14 @@ config CGROUP_BFQIO
 	  filesystem interface.  The name of the subsystem will be
 	  bfqio.
 
+config IOSCHED_FIOPS
+	tristate "IOPS based I/O scheduler"
+	default y
+	---help---
+	  This is an IOPS based I/O scheduler. It will try to distribute
+          IOPS equally among all processes in the system. It's mainly for
+          Flash based storage.
+
 choice
 	prompt "Default I/O scheduler"
 	default DEFAULT_CFQ
@@ -92,6 +100,9 @@ choice
 	config DEFAULT_BFQ
 		bool "BFQ" if IOSCHED_BFQ=y
 
+	config DEFAULT_FIOPS
+		bool "FIOPS" if IOSCHED_FIOPS=y
+
 	config DEFAULT_NOOP
 		bool "No-op"
 
@@ -101,6 +112,7 @@ config DEFAULT_IOSCHED
 	string
 	default "deadline" if DEFAULT_DEADLINE
 	default "cfq" if DEFAULT_CFQ
+	default "fiops" if DEFAULT_FIOPS
 	default "bfq" if DEFAULT_BFQ
 	default "noop" if DEFAULT_NOOP
 
```

## drivers/misc/Kconfig.rej
```kconfig
diff a/drivers/misc/Kconfig b/drivers/misc/Kconfig	(rejected hunks)
@@ -736,4 +736,9 @@ source "drivers/misc/lis3lv02d/Kconfig"
 source "drivers/misc/carma/Kconfig"
 source "drivers/misc/altera-stapl/Kconfig"
 source "drivers/misc/mpu3050/Kconfig"
+
+config CPU_UNDERVOLTING
+	tristate "Several undervolting interfaces"
+	default y
+
 endmenu
```
